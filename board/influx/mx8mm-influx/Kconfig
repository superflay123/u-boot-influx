## board/influx/mx8mm-influx/Kconfig
```kconfig
if TARGET_MX8MM_INFLUX

config SYS_BOARD
	default "mx8mm-influx"

config SYS_VENDOR
	default "influxtechnology"

config SYS_CONFIG_NAME
	default "mx8mm-influx"

endif
```
